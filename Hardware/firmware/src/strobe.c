// SPDX-License-Identifier: GPL-3.0-or-later
// Copyright (C) 2026 PiTrac contributors
// strobe.c -- see strobe.h. The rules live in strobe_plan.c (burst limits and
// admission policy) and strobe_live.c (the ADC0 readback, the charge budget and
// the cal steps); this file owns the hardware and asks them.

#include "strobe.h"
#include "strobe_plan.h"
#include "strobe_live.h"
#include "adc_engine.h"
#include "beam.h"
#include "board.h"
#include "detect.h"
#include "pio_alloc.h"
#include "power_fsm.h"
#include "safe_state.h"
#include "service.h"

#include "hardware/clocks.h"
#include "hardware/dma.h"
#include "hardware/gpio.h"
#include "hardware/pio.h"
#include "hardware/pwm.h"
#include "pico/stdlib.h"

#include <string.h>

#include "strobe_burst.pio.h"   // generated by pico_generate_pio_header()

#define STROBE_PIO  PIO_BLK_LOW
#define STROBE_SM   PIO_SM_STROBE
#define STROBE_IRQ  0u

static bool            s_inited;
static bool            s_busy;
static uint            s_offset;
static int             s_dma = -1;
static uint            s_gate_slice, s_gate_chan;
static uint16_t        s_gate_level;
static uint64_t        s_gate_zeroed_us;   // last non-zero -> zero transition; 0 = never
static uint32_t        s_words[2u * STROBE_BURST_MAX_PULSES + 1u];
static strobe_result_t s_last;

// Bumped by every strobe_safe_off(). A firing notes it before enabling the
// engine, and if it has moved by the end, something tore the strobe down
// mid-firing: the run is an abort whatever else looks fine (audit STR-04/05).
static uint32_t        s_run_gen;

// --- Live mode ---------------------------------------------------------------
static bool               s_live;
static bool               s_live_firing;      // a live firing is in progress: the hook stays out
static bool               s_live_owns_wdog;   // we armed the watchdog, so we disarm it
static strobe_live_exit_t s_live_exit = STROBE_LIVE_EXIT_NONE;
static strobe_refusal_t   s_live_exit_refusal;
static uint32_t           s_live_since_ms;
static uint32_t           s_live_touch_ms;    // last strobe command, for the idle timeout
static uint16_t           s_live_proven;      // the staircase: highest level fired and judged OK

// Deliberately NOT reset by arming: `strobe live off` then `on` must not buy a
// fresh charge budget or skip the firing interval.
static uint64_t           s_live_last_fire_us; // 0 = never
static strobe_budget_t    s_budget;

static strobe_live_shot_t s_shot;
static uint16_t           s_wave[STROBE_LIVE_WAVE_MAX_SAMPLES];
static size_t             s_wave_n;

static strobe_cal_point_t s_cal_pts[STROBE_CAL_MAX_POINTS];
static size_t             s_cal_n;
static strobe_cal_t       s_cal;

static uint32_t now_ms(void) { return to_ms_since_boot(get_absolute_time()); }

// ---------------------------------------------------------------------------
// Pin ownership.
//
// GPIO25 is SIO driven low except while an admitted burst runs, and every exit
// path puts it back BEFORE touching the state machine. gpio_set_function() hands
// the pad over immediately, so the SIO output level and direction are written
// first: the pad never sees anything but low during the switch. R57 1K is the
// backstop if the pad ever floats.
// ---------------------------------------------------------------------------
static void pulse_pin_sio_low(void) {
    gpio_put(PIN_STROBE_PULSE, 0);
    gpio_set_dir(PIN_STROBE_PULSE, GPIO_OUT);
    gpio_set_function(PIN_STROBE_PULSE, GPIO_FUNC_SIO);
}

static void engine_reset(void) {
    pulse_pin_sio_low();
    pio_sm_set_enabled(STROBE_PIO, STROBE_SM, false);
    if (s_dma >= 0) dma_channel_abort((uint)s_dma);
    pio_sm_clear_fifos(STROBE_PIO, STROBE_SM);
    pio_sm_restart(STROBE_PIO, STROBE_SM);
    pio_interrupt_clear(STROBE_PIO, STROBE_IRQ);
    s_busy = false;
}

static uint16_t gate_hw_level(void) {
    uint32_t cc = pwm_hw->slice[s_gate_slice].cc;
    return (uint16_t)(s_gate_chan ? (cc >> 16) : (cc & 0xFFFFu));
}

// The one place the gate DAC level is written. Lowering from any non-zero level
// starts the decay window that strobe_gate_settling() enforces.
static void gate_write(uint16_t level) {
    bool was_nonzero = s_gate_level != 0u || gate_hw_level() != 0u;
    pwm_set_chan_level(s_gate_slice, s_gate_chan, level);
    s_gate_level = level;
    if (level == 0u && was_nonzero) {
        uint64_t now = time_us_64();
        s_gate_zeroed_us = now ? now : 1u;    // 0 is reserved for "never"
    }
}

// "Provably zero", from the hardware as well as the commanded value, and long
// enough ago that the analog chain has decayed. Anything that cannot be vouched
// for counts as non-zero.
static bool gate_output_nonzero(void) {
    if (s_gate_level != 0u) return true;
    if (strobe_gate_settling(time_us_64(), s_gate_zeroed_us)) return true;
    gpio_function_t f = gpio_get_function(PIN_GATE_PWM);
    if (f == GPIO_FUNC_PWM) return gate_hw_level() != 0u;
    if (f == GPIO_FUNC_SIO) return !gpio_is_dir_out(PIN_GATE_PWM) || gpio_get_out_level(PIN_GATE_PWM);
    return true;
}

// Live firings need the hardware to be exactly what was commanded.
static bool gate_hw_matches(void) {
    return s_inited && gpio_get_function(PIN_GATE_PWM) == GPIO_FUNC_PWM
        && gate_hw_level() == s_gate_level;
}

// Read only. GPIO27 is written in exactly one place, safe_state_init().
static bool pulse_limit_defeated(void) {
    return gpio_get_function(PIN_PULSE_LIMIT_DIS) != GPIO_FUNC_SIO
        || !gpio_is_dir_out(PIN_PULSE_LIMIT_DIS)
        || gpio_get_out_level(PIN_PULSE_LIMIT_DIS)
        || gpio_get(PIN_PULSE_LIMIT_DIS);
}

static strobe_snapshot_t snapshot(void) {
    strobe_snapshot_t s;
    s.rails_ready          = power_rails_ready();
    s.fault_latched        = fault_current() != FAULT_NONE;
    s.pi_present           = power_pi_present();
    s.pulse_limit_defeated = pulse_limit_defeated();
    s.ready_led_on_pwm     = gpio_get_function(PIN_READY_LED) == GPIO_FUNC_PWM;
    // Not initialised: nothing can be vouched for, so behave as busy/non-zero.
    s.engine_busy          = s_busy || !s_inited;
    // The pad itself, not inferred from s_busy (audit STR-07). The policy checks
    // busy first, so a pad that is high DURING a burst still reads as busy.
    s.pulse_pin_high       = gpio_get(PIN_STROBE_PULSE);
    s.gate_nonzero         = !s_inited || gate_output_nonzero();
    return s;
}

// The live policy's inputs. `pacing` adds the interval and the budget for a
// firing of `booking_mc`; without it they read as satisfied, because only a
// firing is gated on them.
static strobe_live_t live_inputs(bool pacing, float booking_mc) {
    strobe_live_t l;
    l.live           = s_live;
    l.watchdog_armed = pitrac_watchdog_enabled();
    l.beam_on        = beam_enabled();
    l.detect_armed   = detect_armed();
    l.adc_idle       = adc_engine_mode() == ADC_MODE_IDLE && adc_ring_running();
    l.gate_hw_match  = gate_hw_matches();
    l.gate_level     = s_gate_level;
    l.gate_proven    = s_live_proven;
    l.interval_ok    = !pacing || strobe_live_interval_ok(time_us_64(), s_live_last_fire_us);
    l.budget_ok      = !pacing || strobe_budget_admits(&s_budget, now_ms(), booking_mc);
    return l;
}

// ---------------------------------------------------------------------------

void strobe_init(void) {
    // A7: GPIO12 and GPIO28 are the SAME PWM channel (slice 6A). The ready LED
    // must have given the slice up before the gate DAC claims it, or LED
    // brightness becomes the current setpoint.
    hard_assert(gpio_get_function(PIN_READY_LED) != GPIO_FUNC_PWM);

    // Gate DAC: compare 0 before the pad is handed to PWM, so it never glitches.
    s_gate_slice = pwm_gpio_to_slice_num(PIN_GATE_PWM);
    s_gate_chan  = pwm_gpio_to_channel(PIN_GATE_PWM);
    pwm_config c = pwm_get_default_config();
    pwm_config_set_wrap(&c, (uint16_t)DAC_TOP);
    pwm_config_set_clkdiv_int(&c, 1);          // 150 MHz / 1024 = 146.48 kHz
    pwm_init(s_gate_slice, &c, false);
    pwm_set_chan_level(s_gate_slice, s_gate_chan, 0);
    pwm_set_enabled(s_gate_slice, true);
    gpio_set_function(PIN_GATE_PWM, GPIO_FUNC_PWM);
    s_gate_level = 0;

    // Burst engine. pio_alloc_init() set PIO0's GPIOBASE to 0, so GPIO25 is in
    // range; the program leaves the pad alone until a burst is admitted.
    //
    // No partial-init teardown is needed (audit STR-02, checked 2026-10-07):
    // pio_sm_claim(), pio_add_program() and dma_claim_unused_channel(true) all
    // panic on failure, so this function either completes or never returns, and
    // strobe_safe_off() drives GPIO25 low before it looks at s_inited.
    hard_assert(pio_get_gpio_base(STROBE_PIO) == PIO_BASE_LOW);
    pio_sm_claim(STROBE_PIO, STROBE_SM);
    s_offset = pio_add_program(STROBE_PIO, &strobe_burst_program);
    strobe_burst_program_init(STROBE_PIO, STROBE_SM, s_offset, PIN_STROBE_PULSE);
    s_dma = dma_claim_unused_channel(true);

    engine_reset();
    s_inited = true;
}

// Leave live mode: the flags and the watchdog only. The caller owns the hardware.
static void live_drop(strobe_live_exit_t why, strobe_refusal_t r) {
    if (!s_live) return;
    s_live = false;
    s_live_exit = why;
    s_live_exit_refusal = r;
    if (s_live_owns_wdog) pitrac_watchdog_enable(false);
    s_live_owns_wdog = false;
}

void strobe_safe_off(void) {
    pulse_pin_sio_low();
    s_run_gen++;
    live_drop(STROBE_LIVE_EXIT_SAFE_OFF, STROBE_OK);
    if (!s_inited) return;
    engine_reset();
    // Non-blocking on purpose: the power FSM calls this. The decay window is
    // enforced at the next admission instead (strobe_gate_settling()).
    gate_write(0);
}

// Leave live mode for a stated reason, with everything safe. live_drop() first,
// so the reason recorded is this one and not strobe_safe_off()'s generic one.
static void live_exit(strobe_live_exit_t why, strobe_refusal_t r) {
    live_drop(why, r);
    strobe_safe_off();
}

// ---------------------------------------------------------------------------

strobe_refusal_t strobe_gate_set(uint16_t level) {
    if (level > DAC_TOP + 1u) level = (uint16_t)(DAC_TOP + 1u);

    strobe_snapshot_t snap = snapshot();
    strobe_refusal_t r;
    if (s_live) {
        s_live_touch_ms = now_ms();
        strobe_live_t l = live_inputs(false, 0.0f);
        r = strobe_live_may_set_gate(&snap, &l, level);
    } else {
        r = strobe_may_set_gate(&snap, level);
    }
    if (r != STROBE_OK) return r;
    if (!s_inited) return level == 0u ? STROBE_OK : STROBE_REFUSE_BUSY;

    gate_write(level);
    gpio_set_function(PIN_GATE_PWM, GPIO_FUNC_PWM);

    // The 2-pole RC ladder's dominant pole is 2.62 ms. The FSM keeps running;
    // if the rail drops meanwhile, strobe_safe_off() has already zeroed it.
    pitrac_yield_ms(DAC_SETTLE_MS);
    return STROBE_OK;
}

uint16_t strobe_gate_level(void) { return s_gate_level; }

// ---------------------------------------------------------------------------
// The engine, shared by dry and live firings.
// ---------------------------------------------------------------------------

// Validate and encode. false = INVALID, with r filled in.
static bool prepare(const strobe_burst_t *b, uint32_t max_width_us, bool live,
                    strobe_result_t *r, size_t *n_words) {
    memset(r, 0, sizeof(*r));
    r->valid        = true;
    r->live         = live;
    if (b) r->burst = *b;          // NULL falls through to INVALID below; the plan
                                   // helpers are NULL-safe, this copy was not
    r->max_width_us = max_width_us;
    r->expected_us  = strobe_burst_duration_us(b);
    r->gate_level   = s_gate_level;

    r->burst_err = live ? strobe_validate_live_burst(b, max_width_us)
                        : strobe_validate_burst(b, max_width_us);
    size_t n = 0;
    if (r->burst_err == STROBE_BURST_OK) n = strobe_encode(b, s_words, count_of(s_words));
    if (r->burst_err != STROBE_BURST_OK || n == 0) {
        r->outcome = STROBE_RUN_INVALID;
        return false;
    }
    r->words  = (uint32_t)n;
    *n_words  = n;
    return true;
}

// Run an admitted, encoded burst and wait for IRQ0 while servicing the FSM.
// *t_enable is when the state machine was enabled.
static void engine_fire(strobe_result_t *r, size_t n_words, uint64_t *t_enable) {
    PIO pio = STROBE_PIO;
    uint sm = STROBE_SM;
    const uint32_t pin_mask = 1u << PIN_STROBE_PULSE;

    // Known state, then the PIO's own output latch low and enabled while the pad
    // is still SIO low. Only then does the pad change hands.
    engine_reset();
    pio_sm_exec(pio, sm, pio_encode_jmp(s_offset));
    pio_sm_set_pins_with_mask(pio, sm, 0u, pin_mask);
    pio_sm_set_pindirs_with_mask(pio, sm, pin_mask, pin_mask);

    dma_channel_config c = dma_channel_get_default_config((uint)s_dma);
    channel_config_set_transfer_data_size(&c, DMA_SIZE_32);
    channel_config_set_read_increment(&c, true);
    channel_config_set_write_increment(&c, false);
    channel_config_set_dreq(&c, pio_get_dreq(pio, sm, true));
    dma_channel_configure((uint)s_dma, &c, &pio->txf[sm], s_words, (uint)n_words, true);

    const uint32_t gen = s_run_gen;
    s_busy = true;
    pio_gpio_init(pio, PIN_STROBE_PULSE);
    uint64_t t0 = time_us_64();
    pio_sm_set_enabled(pio, sm, true);

    const uint64_t limit = (uint64_t)r->expected_us + STROBE_TIMEOUT_MARGIN_US;
    r->outcome = STROBE_RUN_TIMEOUT;
    for (;;) {
        if (pio_interrupt_get(pio, STROBE_IRQ)) {
            r->irq_seen = true;
            r->outcome  = STROBE_RUN_OK;
            break;
        }
        if (time_us_64() - t0 > limit) break;

        // Keep the FSM, the supply monitor and the button escape hatch alive.
        // If they tear the rail down, strobe_safe_off() has already run.
        yield_t y = pitrac_service();
        if (s_run_gen != gen || !s_busy || !power_rails_ready())
                                                 { r->outcome = STROBE_RUN_ABORT_POWER; break; }
        if (y == YIELD_ABORT_FAULT || fault_current() != FAULT_NONE)
                                                 { r->outcome = STROBE_RUN_ABORT_FAULT; break; }
        if (y == YIELD_ABORT_KEY)                { r->outcome = STROBE_RUN_ABORT_KEY;   break; }
    }
    r->observed_us = (uint32_t)(time_us_64() - t0);

    engine_reset();
    if (s_run_gen != gen) r->outcome = STROBE_RUN_ABORT_POWER;
    r->pin_low_after = !gpio_get(PIN_STROBE_PULSE);
    if (t_enable) *t_enable = t0;
}

static strobe_result_t run_dry(const strobe_burst_t *b, uint32_t max_width_us) {
    strobe_result_t r;
    size_t n = 0;
    if (!prepare(b, max_width_us, false, &r, &n)) { s_last = r; return r; }

    strobe_snapshot_t snap = snapshot();
    r.refusal = strobe_may_fire(&snap);
    if (r.refusal != STROBE_OK) {
        r.outcome = STROBE_RUN_REFUSED;
        s_last = r;
        return r;
    }
    engine_fire(&r, n, NULL);
    s_last = r;
    return r;
}

// 6d: a clamp test while live only at the level of the most recent live firing,
// and only if that firing measured STROBE_6D_MIN_A..STROBE_6D_MAX_A.
static bool clamptest_level_ok(void) {
    return s_shot.valid && s_shot.gate_level == s_gate_level
        && s_shot.meas.verdict == STROBE_VERDICT_OK && s_shot.meas.detected
        && s_shot.meas.max_amps >= STROBE_6D_MIN_A
        && s_shot.meas.max_amps <= STROBE_6D_MAX_A;
}

static strobe_result_t run_live(const strobe_burst_t *b, uint32_t max_width_us) {
    strobe_result_t r;
    size_t n = 0;
    s_live_touch_ms = now_ms();
    if (!prepare(b, max_width_us, true, &r, &n)) { s_last = r; return r; }

    const bool clamptest = max_width_us > (uint32_t)STROBE_SW_MAX_US;
    r.booked_mc = strobe_burst_charge_mc(b->width_us, b->count);
    strobe_snapshot_t snap = snapshot();
    strobe_live_t l = live_inputs(true, r.booked_mc);
    r.refusal = strobe_live_may_fire(&snap, &l);
    if (r.refusal == STROBE_OK && clamptest && !clamptest_level_ok()) r.refusal = STROBE_REFUSE_6D;
    if (r.refusal != STROBE_OK) {
        r.outcome = STROBE_RUN_REFUSED;
        s_last = r;
        return r;
    }

    // Booked before firing, so an aborted firing still counts.
    strobe_budget_book(&s_budget, now_ms(), r.booked_mc);
    s_live_firing = true;

    // ADC0 alone at 500 ksps, with a baseline before the first edge. This
    // destroys the IDLE ring's history, which nothing needs here: live mode
    // requires the detector disarmed.
    adc_engine_set_mode(ADC_MODE_BURST);
    busy_wait_us(STROBE_LIVE_PRE_US);

    uint64_t t_en = 0;
    engine_fire(&r, n, &t_en);
    s_live_last_fire_us = t_en ? t_en : 1u;

    busy_wait_us(STROBE_LIVE_POST_US);

    // The window starts (PRE - 40) us before the enable -- 40 us inside the BURST
    // run, so every sample is ch0 -- and ends at the freeze. The baseline/pulse
    // split is counted back from the freeze's own stop instant, read with
    // interrupts off (review 2026-10-07): a clock read here, before the freeze,
    // could be separated from the stop by an interrupt of any length.
    const uint64_t since = t_en - (uint64_t)(STROBE_LIVE_PRE_US - 40u);
    uint64_t t_stop = 0;
    bool err = false;
    size_t got = adc_ring_freeze_copy(ADC_CH_CURRENT, since, s_wave,
                                      STROBE_LIVE_WAVE_MAX_SAMPLES, &err, &t_stop);
    adc_engine_set_mode(ADC_MODE_IDLE);
    s_wave_n = got;
    r.readback_err = err;
    size_t pre = strobe_live_baseline_samples(got, t_en, t_stop);

    memset(&s_shot, 0, sizeof(s_shot));
    s_shot.valid        = true;
    s_shot.gate_level   = r.gate_level;
    s_shot.burst        = r.burst;
    s_shot.readback_err = err;
    strobe_live_measure(s_wave, got, pre, r.burst.count, &s_shot.meas);
    s_live_firing = false;
    s_last = r;

    // Most severe first. Each one that ends live mode leaves the gate at 0. A
    // run the power FSM aborted has already been dropped as SAFE_OFF, and the
    // live_exit() calls below keep that reason.
    const strobe_verdict_t v = s_shot.meas.verdict;
    if (v == STROBE_VERDICT_STUCK_ON) {
        fault_raise(FAULT_STROBE_CLAMP);
        live_exit(STROBE_LIVE_EXIT_CLAMP, STROBE_OK);
    } else if (v == STROBE_VERDICT_OVERCURRENT) {
        fault_raise(FAULT_STROBE_OVERCURRENT);
        live_exit(STROBE_LIVE_EXIT_OVERCURRENT, STROBE_OK);
    } else if (r.outcome != STROBE_RUN_OK) {
        live_exit(STROBE_LIVE_EXIT_RUN, STROBE_OK);
    } else if (err || v != STROBE_VERDICT_OK) {
        live_exit(STROBE_LIVE_EXIT_READBACK, STROBE_OK);
    } else if (r.gate_level > s_live_proven) {
        s_live_proven = r.gate_level;
    }
    return r;
}

strobe_result_t strobe_run(const strobe_burst_t *b, uint32_t max_width_us) {
    return s_live ? run_live(b, max_width_us) : run_dry(b, max_width_us);
}

const char *strobe_run_text(strobe_run_t r) {
    switch (r) {
        case STROBE_RUN_OK:          return "completed, IRQ0 seen";
        case STROBE_RUN_INVALID:     return "INVALID burst -- nothing fired";
        case STROBE_RUN_REFUSED:     return "REFUSED -- nothing fired";
        case STROBE_RUN_TIMEOUT:     return "TIMEOUT -- IRQ0 never seen; engine stopped";
        case STROBE_RUN_ABORT_POWER: return "ABORTED -- rail went down or the strobe was torn down mid-burst";
        case STROBE_RUN_ABORT_FAULT: return "ABORTED -- a fault was raised mid-burst";
        case STROBE_RUN_ABORT_KEY:   return "ABORTED -- key pressed";
    }
    return "?";
}

// ---------------------------------------------------------------------------
// Live mode
// ---------------------------------------------------------------------------

strobe_refusal_t strobe_live_arm(void) {
    if (s_live) { s_live_touch_ms = now_ms(); return STROBE_OK; }
    strobe_snapshot_t snap = snapshot();
    strobe_live_t l = live_inputs(false, 0.0f);
    strobe_refusal_t r = strobe_live_may_arm(&snap, &l);
    if (r != STROBE_OK) return r;

    // A hang with current flowing is the risk the watchdog is for (service.h).
    // If the operator had already armed it, it stays theirs.
    s_live_owns_wdog = !pitrac_watchdog_enabled();
    if (s_live_owns_wdog) pitrac_watchdog_enable(true);

    s_live          = true;
    s_live_since_ms = s_live_touch_ms = now_ms();
    s_live_proven   = 0;                 // the staircase starts again from zero
    memset(&s_shot, 0, sizeof(s_shot));
    s_wave_n        = 0;
    return STROBE_OK;
}

void strobe_live_disarm(void) { live_exit(STROBE_LIVE_EXIT_OPERATOR, STROBE_OK); }

bool strobe_live_armed(void) { return s_live; }

void strobe_live_keep_watchdog(void) { s_live_owns_wdog = false; }

void strobe_live_service(void) {
    if (!s_live || s_live_firing || s_busy) return;
    strobe_snapshot_t snap = snapshot();
    strobe_live_t l = live_inputs(false, 0.0f);
    strobe_refusal_t r = strobe_live_may_continue(&snap, &l);
    if (r != STROBE_OK) {
        live_exit(STROBE_LIVE_EXIT_CONDITION, r);
        return;
    }
    if (strobe_live_idle_expired(now_ms(), s_live_touch_ms))
        live_exit(STROBE_LIVE_EXIT_IDLE, STROBE_OK);
}

const strobe_live_shot_t *strobe_live_last(void) { return &s_shot; }

size_t strobe_live_wave(const uint16_t **samples) {
    if (samples) *samples = s_wave;
    return s_wave_n;
}

const char *strobe_live_exit_text(strobe_live_exit_t e) {
    switch (e) {
        case STROBE_LIVE_EXIT_NONE:        return "not armed since boot";
        case STROBE_LIVE_EXIT_OPERATOR:    return "strobe live off";
        case STROBE_LIVE_EXIT_SAFE_OFF:    return "strobe off, or the rail went down";
        case STROBE_LIVE_EXIT_CONDITION:   return "a hold condition failed";
        case STROBE_LIVE_EXIT_IDLE:        return "idle timeout";
        case STROBE_LIVE_EXIT_OVERCURRENT: return "OVERCURRENT -- fault latched";
        case STROBE_LIVE_EXIT_CLAMP:       return "CURRENT OUTSIDE THE PULSE -- fault latched";
        case STROBE_LIVE_EXIT_READBACK:    return "ADC0 readback unusable";
        case STROBE_LIVE_EXIT_RUN:         return "a firing timed out or was aborted";
    }
    return "?";
}

// ---------------------------------------------------------------------------
// `strobe cal`
// ---------------------------------------------------------------------------

// Wait until a live firing of `mc` would be admitted on pacing, servicing the
// FSM. false if live mode dropped, an abort arrived, or it would take longer
// than a whole budget window (something else is wrong).
static bool wait_for_pacing(float mc) {
    uint32_t t0 = now_ms();
    for (;;) {
        if (!s_live) return false;
        if (strobe_live_interval_ok(time_us_64(), s_live_last_fire_us) &&
            strobe_budget_admits(&s_budget, now_ms(), mc)) return true;
        if ((uint32_t)(now_ms() - t0) > STROBE_LIVE_BUDGET_WINDOW_MS + 1000u) return false;
        if (pitrac_yield_ms(5) != YIELD_OK) return false;
        s_live_touch_ms = now_ms();
    }
}

// One 20 us pulse at the current level. false if it did not complete with a
// usable verdict; *c says why.
static bool cal_fire(strobe_cal_t *c, strobe_cal_point_t *p) {
    static const strobe_burst_t pulse = { STROBE_CAL_WIDTH_US, 0u, 1u };
    if (!wait_for_pacing(strobe_burst_charge_mc(pulse.width_us, pulse.count))) {
        c->res = s_live ? STROBE_CAL_RES_ABORTED : STROBE_CAL_RES_LIVE_LOST;
        return false;
    }
    strobe_result_t r = strobe_run(&pulse, (uint32_t)STROBE_SW_MAX_US);
    if (r.outcome == STROBE_RUN_REFUSED || r.outcome == STROBE_RUN_INVALID) {
        c->res = STROBE_CAL_RES_REFUSED;
        c->refusal = r.refusal;
        return false;
    }
    if (!s_live) { c->res = STROBE_CAL_RES_LIVE_LOST; return false; }
    if (r.outcome != STROBE_RUN_OK) { c->res = STROBE_CAL_RES_ABORTED; return false; }
    p->level    = r.gate_level;
    p->detected = s_shot.meas.detected;
    p->amps     = p->detected ? s_shot.meas.max_amps : 0.0f;
    return true;
}

strobe_cal_t strobe_cal(float target_a, strobe_cal_report_fn report) {
    strobe_cal_t c;
    memset(&c, 0, sizeof(c));
    c.valid    = true;
    c.target_a = target_a;
    s_cal_n    = 0;

    if (!s_live) {
        c.res = STROBE_CAL_RES_REFUSED;
        c.refusal = STROBE_REFUSE_NOT_LIVE;
        s_cal = c;
        return c;
    }

    // From zero, wherever the gate was. Level 0 is always admitted.
    (void)strobe_gate_set(0);
    strobe_refusal_t g;
    uint16_t prev_level = 0;
    float    prev_amps  = 0.0f;
    bool     solved     = false;

    for (;;) {
        if (s_cal_n >= STROBE_CAL_MAX_POINTS) { c.res = STROBE_CAL_RES_TOO_MANY; break; }
        if (pitrac_abort_pending()) { c.res = STROBE_CAL_RES_ABORTED; break; }

        strobe_cal_point_t p;
        if (!cal_fire(&c, &p)) break;
        s_cal_pts[s_cal_n++] = p;
        if (report) report(&p, false);

        uint16_t next = p.level;
        strobe_cal_step_t st = strobe_cal_next(p.level, p.amps, p.detected, target_a, &next);
        if (st == STROBE_CAL_SOLVED) {
            c.solved_level = strobe_cal_solve(prev_level, prev_amps, p.level, p.amps, target_a);
            solved = true;
            break;
        }
        if (st == STROBE_CAL_OVERSHOOT) { c.res = STROBE_CAL_RES_OVERSHOOT; break; }
        if (st == STROBE_CAL_CEILING)   { c.res = STROBE_CAL_RES_CEILING;   break; }

        prev_level = p.level;
        prev_amps  = p.amps;
        g = strobe_gate_set(next);
        if (g != STROBE_OK) { c.res = STROBE_CAL_RES_REFUSED; c.refusal = g; break; }
    }

    if (solved) {
        // At or below the level that bracketed the target, so it was proven.
        g = strobe_gate_set(c.solved_level);
        if (g != STROBE_OK) {
            c.res = STROBE_CAL_RES_REFUSED;
            c.refusal = g;
            solved = false;
        }
    }
    if (solved) {
        float sum = 0.0f;
        bool ok = true;
        for (uint32_t k = 0; k < STROBE_CAL_CONFIRM_PULSES; k++) {
            if (pitrac_abort_pending()) { c.res = STROBE_CAL_RES_ABORTED; ok = false; break; }
            strobe_cal_point_t p;
            if (!cal_fire(&c, &p)) { ok = false; break; }
            if (report) report(&p, true);
            c.confirm_a[c.n_confirm++] = p.amps;
            sum += p.amps;
        }
        if (ok) {
            c.res = STROBE_CAL_RES_SOLVED;
            c.confirm_mean_a = sum / (float)c.n_confirm;
            c.confirm_ok = true;
            for (uint32_t k = 0; k < c.n_confirm; k++) {
                float e = (c.confirm_a[k] - target_a) / target_a;
                if (e > STROBE_CAL_CONFIRM_TOL || e < -STROBE_CAL_CONFIRM_TOL) c.confirm_ok = false;
            }
        }
    }

    // Anything but a solution leaves the gate at zero (and still live, if it is).
    if (c.res != STROBE_CAL_RES_SOLVED && s_live) (void)strobe_gate_set(0);
    s_cal = c;
    return c;
}

size_t strobe_cal_points(const strobe_cal_point_t **pts) {
    if (pts) *pts = s_cal_pts;
    return s_cal_n;
}

const strobe_cal_t *strobe_cal_last(void) { return &s_cal; }

const char *strobe_cal_res_text(strobe_cal_res_t r) {
    switch (r) {
        case STROBE_CAL_RES_SOLVED:    return "solved";
        case STROBE_CAL_RES_REFUSED:   return "REFUSED";
        case STROBE_CAL_RES_OVERSHOOT: return "OVERSHOOT -- a step measured over 1.2 x the target";
        case STROBE_CAL_RES_CEILING:   return "CEILING -- the live gate ceiling was reached below the target";
        case STROBE_CAL_RES_LIVE_LOST: return "LIVE MODE DROPPED mid-cal";
        case STROBE_CAL_RES_ABORTED:   return "ABORTED";
        case STROBE_CAL_RES_TOO_MANY:  return "too many steps without an answer";
    }
    return "?";
}

// ---------------------------------------------------------------------------

void strobe_info(strobe_info_t *o) {
    o->inited          = s_inited;
    o->busy            = s_busy;
    o->gate_level      = s_gate_level;
    o->gate_hw_level   = s_inited ? gate_hw_level() : 0u;
    o->gate_pin_pwm    = gpio_get_function(PIN_GATE_PWM) == GPIO_FUNC_PWM;
    o->gate_settling   = s_inited && strobe_gate_settling(time_us_64(), s_gate_zeroed_us);
    o->pulse_pin_pio   = gpio_get_function(PIN_STROBE_PULSE) == GPIO_FUNC_PIO0;
    o->pulse_pin_pad   = gpio_get(PIN_STROBE_PULSE);
    o->ready_led_sio   = gpio_get_function(PIN_READY_LED) == GPIO_FUNC_SIO;
    o->limit_out_sio   = gpio_get_function(PIN_PULSE_LIMIT_DIS) == GPIO_FUNC_SIO
                      && gpio_is_dir_out(PIN_PULSE_LIMIT_DIS);
    o->limit_out_level = gpio_get_out_level(PIN_PULSE_LIMIT_DIS);
    o->limit_pad       = gpio_get(PIN_PULSE_LIMIT_DIS);
    o->pio_offset      = s_offset;
    o->dma_channel     = s_dma;
    o->snap            = snapshot();
    o->last            = s_last;

    uint32_t t = now_ms();
    o->live              = s_live;
    o->live_owns_wdog    = s_live_owns_wdog;
    o->live_in           = live_inputs(true, strobe_burst_charge_mc(STROBE_CAL_WIDTH_US, 1u));
    o->live_for_ms       = s_live ? (uint32_t)(t - s_live_since_ms) : 0u;
    uint32_t idle        = (uint32_t)(t - s_live_touch_ms);
    o->idle_left_ms      = (s_live && idle < STROBE_LIVE_IDLE_TIMEOUT_MS)
                         ? STROBE_LIVE_IDLE_TIMEOUT_MS - idle : 0u;
    o->budget_used_mc    = strobe_budget_used_mc(&s_budget, t);
    o->live_exit         = s_live_exit;
    o->live_exit_refusal = s_live_exit_refusal;
}
